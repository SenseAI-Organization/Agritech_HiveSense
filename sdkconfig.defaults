## sdkconfig.defaults
```kconfig
#
# Bluetooth Configuration
#
CONFIG_BT_ENABLED=y
CONFIG_BT_BLE_ENABLED=y
CONFIG_BT_BLUEDROID_ENABLED=y
CONFIG_BT_NIMBLE_ENABLED=n
CONFIG_BT_CONTROLLER_ENABLED=y

# BLE Features
CONFIG_BT_BLE_50_FEATURES_SUPPORTED=n
CONFIG_BT_BLE_42_FEATURES_SUPPORTED=y

# Controller Configuration
CONFIG_BT_CONTROLLER_BLE_MAX_CONN=3
CONFIG_BT_CONTROLLER_BLE_MAX_CONN_EFF=3

# GATT Configuration
CONFIG_BT_GATT_MAX_SR_PROFILES=8
CONFIG_BT_GATT_MAX_SR_ATTRIBUTES=100

# Bluedroid Configuration  
CONFIG_BT_BLUEDROID_PINNED_TO_CORE_0=y
CONFIG_BT_BLUEDROID_PINNED_TO_CORE=0
CONFIG_BT_BTU_TASK_STACK_SIZE=4096

# Disable Classic Bluetooth
CONFIG_BT_CLASSIC_ENABLED=n
CONFIG_BT_A2DP_ENABLE=n
CONFIG_BT_SPP_ENABLED=n

# Security
CONFIG_BT_BLE_SMP_ENABLE=y
CONFIG_BT_BLE_SMP_MAX_BONDS=10

# Memory
CONFIG_BT_RESERVE_DRAM=0x10000
```
